## package/bunnymenu/Config.in
```kconfig
config BR2_PACKAGE_BUNNYMENU
        bool "bunnymenu"
	depends on BR2_INSTALL_LIBSTDCPP
        help
          A lightweight emulator picker/menu.

comment "Bunnymenu needs a toolchain w/ C++"
	depends on !BR2_INSTALL_LIBSTDCPP
```

## package/esp8089/Config.in
```kconfig
config BR2_PACKAGE_ESP8089
        bool "esp8089"
        help
          Kernel driver for the ESP8089 wireless chip contained in the ESP-12F and Didj-Fi cartridge.

          esp8089 needs a Linux kernel to be built
          https://github.com/al177/esp8089/
          https://github.com/jkent/Didj-Fi
```

## package/gmenunx/Config.in
```kconfig
config BR2_PACKAGE_GMENUNX
        bool "gmenunx"
	depends on BR2_INSTALL_LIBSTDCPP
        help
          An emulator menu based on original work for the GP2X

comment "Bunnymenu needs a toolchain w/ C++"
	depends on !BR2_INSTALL_LIBSTDCPP
```

## package/gpsp/Config.in
```kconfig
config BR2_PACKAGE_GPSP
        bool "gpsp"
	depends on BR2_INSTALL_LIBSTDCPP
        help
          ARM-optimized gameboy emulator by notaz

comment "Gpsp needs a toolchain w/ C++"
	depends on !BR2_INSTALL_LIBSTDCPP
```

## package/libretro-core-info/Config.in
```kconfig
config BR2_PACKAGE_LIBRETRO_CORE_INFO
        bool "libretro-core-info"
	depends on BR2_PACKAGE_RETROARCH
	depends on BR2_INSTALL_LIBSTDCPP
        help
          Core info files for Retroarch. You need this to run cores. 

	  http://www.libretro.com
```

## package/ohboy/Config.in
```kconfig
config BR2_PACKAGE_OHBOY
        bool "ohboy"
	depends on BR2_INSTALL_LIBSTDCPP
        help
          Gameboy/Gameboy color emulator

comment "Ohboy needs a toolchain w/ C++"
	depends on !BR2_INSTALL_LIBSTDCPP
```

## package/picodrive/Config.in
```kconfig
config BR2_PACKAGE_PICODRIVE
        bool "picodrive"
	depends on BR2_INSTALL_LIBSTDCPP
        help
          ARM-optimized megadrive emulator by notaz

comment "Picodrive needs a toolchain w/ C++"
	depends on !BR2_INSTALL_LIBSTDCPP
```

## package/pocketsnes/Config.in
```kconfig
config BR2_PACKAGE_POCKETSNES
        bool "pocketsnes"
	depends on BR2_INSTALL_LIBSTDCPP
        help
          ARM-optimized SNES emulator

comment "Pocketsnes needs a toolchain w/ C++"
	depends on !BR2_INSTALL_LIBSTDCPP
```

## package/retroarch/Config.in
```kconfig
config BR2_PACKAGE_RETROARCH
        bool "Retroarch"
        depends on BR2_PACKAGE_LIBRETRO_CORE_INFO
        help
          A multi emulator frontend.

	  http://www.libretro.com

#if BR2_PACKAGE_RETROARCH
#config BR2_PACKAGE_RETROARCH_RPI1
#        bool "Compile for RPI1"
#        help
#		Compile for rpi1
#endif
```

## package/warm/Config.in
```kconfig
config BR2_PACKAGE_WARM
        bool "warm"
        help
          Kernel module for cache control, needed by gpsp
```
